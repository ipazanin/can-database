VERSION ""

NS_ :

BS_:

BU_: ECUVariantIdent GW Tester ECU

BO_ 257 SendStoreData: 8 Tester
 SG_ SawTooth : 32|32@1- (1,0) [0|0] "" Vector__XXX
 SG_ Sinus : 0|32@1- (1,0) [0|0] "" Vector__XXX

BA_DEF_ BU_  "TpTxIdentifier" HEX 0 2047;
BA_DEF_ BU_  "TpRxIdentifier" HEX 0 2047;
BA_DEF_ BU_  "Diagnose-Stationsadresse" INT -1 255;
BA_DEF_ BU_  "TpAddressingMode" INT 0 3;
BA_DEF_ BU_  "NodeLayerModules" STRING ;
BA_DEF_  "BusType" STRING ;
BA_DEF_DEF_  "TpTxIdentifier" 0;
BA_DEF_DEF_  "TpRxIdentifier" 0;
BA_DEF_DEF_  "Diagnose-Stationsadresse" -1;
BA_DEF_DEF_  "TpAddressingMode" 1;
BA_DEF_DEF_  "NodeLayerModules" "osek_tp.dll";
BA_DEF_DEF_  "BusType" "CAN";
BA_ "TpTxIdentifier" BU_ ECUVariantIdent 1538;
BA_ "TpRxIdentifier" BU_ ECUVariantIdent 1794;
BA_ "Diagnose-Stationsadresse" BU_ ECUVariantIdent 3;
BA_ "TpAddressingMode" BU_ ECUVariantIdent 0;
BA_ "TpTxIdentifier" BU_ GW 1537;
BA_ "TpRxIdentifier" BU_ GW 1793;
BA_ "Diagnose-Stationsadresse" BU_ GW 2;
BA_ "TpAddressingMode" BU_ GW 0;
BA_ "NodeLayerModules" BU_ GW "DoIP.dll,osek_tp.dll";
BA_ "TpTxIdentifier" BU_ Tester 1792;
BA_ "Diagnose-Stationsadresse" BU_ Tester 0;
BA_ "TpRxIdentifier" BU_ Tester 1536;
BA_ "TpAddressingMode" BU_ Tester 0;
BA_ "TpTxIdentifier" BU_ ECU 1536;
BA_ "Diagnose-Stationsadresse" BU_ ECU 1;
BA_ "TpRxIdentifier" BU_ ECU 1792;
BA_ "TpAddressingMode" BU_ ECU 0;
SIG_VALTYPE_ 257 SawTooth : 1;
SIG_VALTYPE_ 257 Sinus : 1;
