VERSION "HIPBNYYYYYYYYYYYYYYYYYYYYYYYYYYYNNNNNNNNNN/4/%%%/4/'%**4NNN///"

NS_ :

BS_:

BU_: USER IPETRONIK

BO_ 12 SIM_50100000_ID_C: 4 IPETRONIK
 SG_ Thermo2 : 16|16@1- (0.0190738,575.01) [-51|1200] "Celsius"  USER
 SG_ Thermo1 : 0|16@1- (0.0190738,575.01) [-51|1200] "Celsius"  USER

BA_DEF_ SG_  "CANtoolDecimalPlace" INT -1 8;
BA_DEF_DEF_  "CANtoolDecimalPlace" -1;
BA_ "CANtoolDecimalPlace" SG_ 12 Thermo2 2;
BA_ "CANtoolDecimalPlace" SG_ 12 Thermo1 2;
